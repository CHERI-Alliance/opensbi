## platform/generic/configs/hobgoblin_defconfig
```kconfig
CONFIG_PLATFORM_ALLWINNER_D1=n
CONFIG_PLATFORM_ANDES_AE350=n
CONFIG_PLATFORM_RENESAS_RZFIVE=n
CONFIG_PLATFORM_SIFIVE_FU540=n
CONFIG_PLATFORM_SIFIVE_FU740=n
CONFIG_FDT_GPIO=n
CONFIG_FDT_GPIO_SIFIVE=n
CONFIG_FDT_I2C=n
CONFIG_FDT_I2C_SIFIVE=n
CONFIG_FDT_IPI=y
CONFIG_FDT_IPI_MSWI=y
CONFIG_FDT_IPI_PLICSW=n
CONFIG_FDT_IRQCHIP=y
CONFIG_FDT_IRQCHIP_APLIC=n
CONFIG_FDT_IRQCHIP_IMSIC=n
CONFIG_FDT_IRQCHIP_PLIC=y
CONFIG_FDT_RESET=n
CONFIG_FDT_RESET_ATCWDT200=n
CONFIG_FDT_RESET_GPIO=n
CONFIG_FDT_RESET_HTIF=n
CONFIG_FDT_RESET_SIFIVE_TEST=n
CONFIG_FDT_RESET_SUNXI_WDT=n
CONFIG_FDT_RESET_THEAD=n
CONFIG_FDT_SERIAL=y
CONFIG_FDT_SERIAL_CADENCE=n
CONFIG_FDT_SERIAL_GAISLER=n
CONFIG_FDT_SERIAL_HTIF=n
CONFIG_FDT_SERIAL_RENESAS_SCIF=n
CONFIG_FDT_SERIAL_SHAKTI=n
CONFIG_FDT_SERIAL_SIFIVE=n
CONFIG_FDT_SERIAL_LITEX=n
CONFIG_FDT_SERIAL_UART8250=y
CONFIG_FDT_SERIAL_XILINX_UARTLITE=n
CONFIG_FDT_TIMER=y
CONFIG_FDT_TIMER_MTIMER=y
CONFIG_FDT_TIMER_PLMT=n
CONFIG_SERIAL_SEMIHOSTING=n
```
